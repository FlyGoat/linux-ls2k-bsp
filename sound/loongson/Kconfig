## sound/loongson/Kconfig
```kconfig
menuconfig SND_HDA_LS7A
	bool "Loongson7A HD Audio"
	select SND_PCM
	select SND_VMASTER
	help
	  Say Y here to include support for "Loongson7A High Definition
	  Audio".

if SND_HDA_LS7A

config LS7A_HDA_POWER_SAVE
	bool "Aggressive power-saving on HD-audio"
	help
	  Say Y here to enable more aggressive power-saving mode on
	  HD-audio driver.  The power-saving timeout can be configured
	  via power_save option or over sysfs on-the-fly.

config LS7A_HDA_POWER_SAVE_DEFAULT
	int "Default time-out for HD-audio power-save mode"
    depends on LS7A_HDA_POWER_SAVE
	default 0
	  help
	  The default time-out value in seconds for HD-audio automatic
	  power-save mode.  0 means to disable the power-save mode.

endif
```

## sound/soc/loongson/Kconfig
```kconfig
config SND_LS1X
	tristate "SoC Audio for the LS1X chip"
	depends on MACH_LOONGSON2K
	help
	  Say Y or M if you want to add support for codecs attached to
	  the PXA2xx AC97, I2S or SSP interface. You will also need
	  to select the audio interfaces to support below.


config SND_LS1X_COCEC_AC97
	tristate
	select AC97_BUS
	select SND_MIPS
	select SND_SOC_AC97_BUS
	select SND_SOC_AC97_CODEC
	select SND_AC97_CODEC


config SND_LS1X_AC97
	tristate "SoC AC97 Audio support for Loongson1A chip"
	depends on SND_LS1X
	select SND_LS1X_COCEC_AC97
	help
	  Say Y if you want to add support for SoC audio on the
	  Loongson 1A chip
```
